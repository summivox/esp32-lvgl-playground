## sdkconfig.defaults
```kconfig
# NOTE: Since `sdkconfig` is excluded by `.gitignore`, this file can be used instead to specify the most important options.
# See https://docs.espressif.com/projects/esp-idf/en/latest/esp32/api-guides/build-system.html#custom-sdkconfig-defaults

CONFIG_ESP_SYSTEM_PANIC_PRINT_HALT=y

CONFIG_ESP32_DEFAULT_CPU_FREQ_240=y
CONFIG_ESP32_DEFAULT_CPU_FREQ_MHZ=240

# If you encounter any flashing issues, try comment out / remove the following lines.
CONFIG_ESPTOOLPY_FLASHMODE_QIO=y
CONFIG_ESPTOOLPY_FLASHFREQ_80M=y
CONFIG_ESPTOOLPY_FLASHFREQ="80m"

CONFIG_COMPILER_OPTIMIZATION_PERF=y
CONFIG_COMPILER_CXX_EXCEPTIONS=y
CONFIG_COMPILER_CXX_EXCEPTIONS_EMG_POOL_SIZE=512

# Use the same baud rate for MONITOR and ESP32 default UART
CONFIG_ESPTOOLPY_MONITOR_BAUD_CONSOLE=y

CONFIG_FREERTOS_HZ=1000

#######################################################################################

CONFIG_UART_ISR_IN_IRAM=y


### LVGL

CONFIG_LV_ATTRIBUTE_FAST_MEM_USE_IRAM=y
CONFIG_LV_CONF_MINIMAL=y
CONFIG_LV_CONF_SKIP=y

CONFIG_LV_COLOR_DEPTH_1=y
CONFIG_LV_COLOR_DEPTH=1
CONFIG_LV_COLOR_CHROMA_KEY_HEX=0x00FF00

CONFIG_LV_MEM_CUSTOM=y
CONFIG_LV_MEM_CUSTOM_INCLUDE="stdlib.h"
CONFIG_LV_MEMCPY_MEMSET_STD=y

CONFIG_LV_DISP_DEF_REFR_PERIOD=50
CONFIG_LV_INDEV_DEF_READ_PERIOD=50
CONFIG_LV_TICK_CUSTOM=y
CONFIG_LV_TICK_CUSTOM_INCLUDE="lvgl_tick.h"
CONFIG_LV_DPI_DEF=100

CONFIG_LV_DRAW_COMPLEX=y
CONFIG_LV_SHADOW_CACHE_SIZE=0
CONFIG_LV_IMG_CACHE_DEF_SIZE=0

CONFIG_LV_USE_USER_DATA=y

CONFIG_LV_USE_THEME_BASIC=y

CONFIG_LV_USE_SPINBOX=y
CONFIG_LV_USE_TABVIEW=y
CONFIG_LV_USE_TILEVIEW=y

CONFIG_LV_USE_FLEX=y
CONFIG_LV_USE_GRID=y
```
